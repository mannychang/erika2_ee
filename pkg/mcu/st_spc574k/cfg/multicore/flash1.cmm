; Script for SPC574K (K2)
; Author: Francesco Esposito
; Company: Evidence Srl
; 29-5-2014
; Note: derived from Lauterbach script
;

Data.LOAD "slave/myProject_slave.elf" /NoCode

; evi - call orti.cmm if needed
cd slave
#ORTICMD#
cd ..

ENDDO

