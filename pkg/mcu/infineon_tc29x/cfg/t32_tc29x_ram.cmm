; Script file for TC297TA on TRIBOARD-TC2X7
;
; Initializes the TriCore and loads ELF into memory.
;
;
;

;========================================================================
; initialize and start the debugger

  IF SYStem.MODE()<5
  (
    SYStem.RESet
    SYStem.CPU TC297TA
    CORE.select 0.	; CPU0 is selected for flash programming.
    SYStem.Up
  )

  ; Disable Watchdog Timers on TC29xT[E]

  ; Disable the Safety Watchdog Timer (overall system level watchdog):
  PER.Set D:0xF00360F4 %Long 0x00000008 // SCU_WDTSCON1, Request to disable the WDT
  ; Disable the CPU Watchdog Timers:
  PER.Set D:0xF0036104 %Long 0x00000008 // SCU_WDTCPU0CON1, Request to disable the WDT
  PER.Set D:0xF0036110 %Long 0x00000008 // SCU_WDTCPU1CON1, Request to disable the WDT
  PER.Set D:0xF003611C %Long 0x00000008 // SCU_WDTCPU2CON1, Request to disable the WDT

;========================================================================
; load demo program
  Data.LOAD.auto   "#EXE_NAME#"
  IF Analyzer()
  (
    ; Workaround for AGBT "RLINE repetition" issue:
    ; - AURIX A-STEP devices only (will be fixed with B-Step)
    ; - only required when PLL is not configured
    ; - when configuring PLL make sure that this workaround is included
    ; Desription: issue will cause corrupted trace data
    ; Workaround: f(MAX) = f(MCDS) = f(BBB)
    ; For 100MHz: MAXDIV = 0x2, BBBDIV = 0x1, MCDSDIV = 0x1
    ; For 50MHz:  MAXDIV = 0x4, BBBDIV = 0x1, MCDSDIV = 0x1
    ;PER.Set D:0xF0036034 %Long (Data.Long(D:0xF0036034)&~0x00F)|0x002   ; MAXDIV = 0x2, for 100 MHz
    ;PER.Set D:0xF0036034 %Long (Data.Long(D:0xF0036034)&~0x00F)|0x004  ; MAXDIV = 0x4, for 50 MHz
    ;PER.Set D:0xF0036040 %Long (Data.Long(D:0xF0036040)&~0xF0F)|0x101   ; BBBDIV = 0x1, MCDSDIV = 0x1
  )

  #ORTICMD#

; open some windows
;  WinCLEAR
;  WinPOS 0% 0% 100% 50%
;  Data.List
;  WinPOS 0% 50% 50% 50%
;  Var.Frame /Locals /Caller
;  WinPOS 50% 50% 50% 50%

ENDDO
