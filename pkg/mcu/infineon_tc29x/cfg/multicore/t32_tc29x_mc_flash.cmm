;
; Script for flash declaration and programming of Infineon
; TriCore TC29x internal flash.
;
; Supported devices: All TC29xT and TC29xTE devices, e.g. TC298T.
;
; Flash:
;   8 MByte on-chip program flash      at 0x80000000--0x807FFFFF (cached)
;                                      or 0xA0000000--0xA07FFFFF (non cached)
;   768 kByte DF0 EEPROM               at 0xAF000000--0xAF0BFFFF
;   16 kByte DF0 UCB sectors           at 0xAF100000--0xAF103FFF
;   64 kByte DF1 HSM sectors           at 0xAF110000--0xAF11FFFF
;
; RAM:
;   120 kByte Data Scratch-Pad RAM (DSPR) at        0xD0000000--0xD001DFFF
;    32 kByte Instruction Scratch-Pad RAM (PSPR) at 0xC0000000--0xC0007FFF
;
; HINTS:
;
;   Erased flash is showing bus error caused by ECC error. ECC width is one
;   page. In the PFlash a page is an aligned group of 32 bytes and in DFlash
;   of 8 bytes.
;
;   The flash algorithm is programming PFlash in an aligned group of 32 bytes.
;   When using FLASH.Program command the download has to care about this
;   alignment.
;
;   To avoid any aligment issues FLASH.ReProgram is recommended. Unused flash
;   data of affected sectors is programmed to 0x0.
;
;   FLASH.AUTO is not working for sectors with enabled ECC and uncorrectable
;   ECC error (showing bus error).
;
; CAUTION:
;
;   Do not reboot or unpower your device in case all BMHD (Boot Mode Headers)
;   do not contain valid information. This is normally the case after having
;   erased the internal program flash or loading an object or binary file
;   without a valid BMHD. The BMHD are located at:
;     BMHD0 0xA0000000--0xA000001F
;     BMHD1 0xA0020000--0xA002001F
;     BMHD2 0xA000FFE0--0xA000FFFF
;     BMHD3 0xA001FFE0--0xA001FFFF
;   See the Infineon documentation for more information.
;
;   Do not enable HSM boot when no valid HSM code is present. This will lock
;   your device permanently. See the Infineon documentation and contact your
;   Infineon FAE for more information on HSM.
;
;   Pay special attention when modifying the UCB. An invalid or erroneous
;   content will lock your device permanently. This also happens in case the
;   confirmation code is neither "unlocked" nor "confirmed". See the Infineon
;   documentation for more information.

  ;========================================================================
  ; Initialize and start debugging
  LOCAL &master_elf &cpu1_elf &cpu2_elf
  &master_elf="#MASTER_ELF#"
  &cpu1_elf="#CPU1_ELF#"
  &cpu2_elf="#CPU2_ELF#"

  IF SYStem.MODE()<5
  (
    SYStem.RESet
    SYStem.CPU TC297TA
    CORE.ASSIGN 1	; CPU0 is selected for flash programming.
    SYStem.Up
  )

  ; Disable Watchdog Timers on TC29xT[E]

  ; Disable the Safety Watchdog Timer (overall system level watchdog):
  PER.Set D:0xF00360F4 %Long 0x00000008 ; SCU_WDTSCON1, Request to disable the WDT
  ; Disable the CPU Watchdog Timers:
  PER.Set D:0xF0036104 %Long 0x00000008 ; SCU_WDTCPU0CON1, Request to disable the WDT
  PER.Set D:0xF0036110 %Long 0x00000008 ; SCU_WDTCPU1CON1, Request to disable the WDT
  PER.Set D:0xF003611C %Long 0x00000008 ; SCU_WDTCPU2CON1, Request to disable the WDT

  ;========================================================================
  ; Flash Declaration

  IF VERSION.BUILD()<38225.
  (
    DIALOG.OK "Please request a Trace32 software update to support Boot Mode Header handling"
    ENDDO
  )

  FLASH.RESet

  ; Program flash PF0
  FLASH.Create  1. 0xA0000000--0xA000BFFF  0x4000 TARGET Long /BootModeHeaDer 0xA0000000--0xA000001F  ; PS0, S0..S2
  FLASH.Create  1. 0xA000C000--0xA0013FFF  0x4000 TARGET Long /BootModeHeaDer 0xA000FFE0--0xA000FFFF  ; PS0, S3..S4
  FLASH.Create  1. 0xA0014000--0xA0017FFF  0x4000 NOP    Long /INFO "Tuning Protection"               ; PS0, S5
  FLASH.Create  1. 0xA0018000--0xA001BFFF  0x4000 NOP    Long /INFO "HSM code sector"                 ; PS0, S6
  FLASH.Create  1. 0xA001C000--0xA001FFFF  0x4000 TARGET Long /BootModeHeaDer 0xA001FFE0--0xA001FFFF  ; PS0, S7
  FLASH.Create  1. 0xA0020000--0xA005FFFF  0x8000 TARGET Long /BootModeHeaDer 0xA0020000--0xA002001F  ; PS0, S8..S15
  FLASH.Create  1. 0xA0060000--0xA007FFFF 0x10000 NOP    Long /INFO "HSM code sector"                 ; PS0, S16..S17
  FLASH.Create  2. 0xA0080000--0xA009FFFF 0x10000 TARGET Long   ; PS1, S18..S19
  FLASH.Create  2. 0xA00A0000--0xA00FFFFF 0x20000 TARGET Long   ; PS1, S20..S22
  FLASH.Create  3. 0xA0100000--0xA017FFFF 0x40000 TARGET Long   ; PS2, S23..S24
  FLASH.Create  4. 0xA0180000--0xA01FFFFF 0x40000 TARGET Long   ; PS3, S25..S26
  ; Program flash PF1
  FLASH.Create  5. 0xA0200000--0xA021FFFF  0x4000 TARGET Long   ; PS0, S0..S7
  FLASH.Create  5. 0xA0220000--0xA025FFFF  0x8000 TARGET Long   ; PS0, S8..S15
  FLASH.Create  5. 0xA0260000--0xA027FFFF 0x10000 TARGET Long   ; PS0, S16..S17
  FLASH.Create  6. 0xA0280000--0xA029FFFF 0x10000 TARGET Long   ; PS1, S18..S19
  FLASH.Create  6. 0xA02A0000--0xA02FFFFF 0x20000 TARGET Long   ; PS1, S20..S22
  FLASH.Create  7. 0xA0300000--0xA037FFFF 0x40000 TARGET Long   ; PS2, S23..S24
  FLASH.Create  8. 0xA0380000--0xA03FFFFF 0x40000 TARGET Long   ; PS3, S25..S26
  ; Program flash PF2
  FLASH.Create  9. 0xA0400000--0xA041FFFF  0x4000 TARGET Long   ; PS0, S0..S7
  FLASH.Create  9. 0xA0420000--0xA045FFFF  0x8000 TARGET Long   ; PS0, S8..S15
  FLASH.Create  9. 0xA0460000--0xA047FFFF 0x10000 TARGET Long   ; PS0, S16..S17
  FLASH.Create 10. 0xA0480000--0xA049FFFF 0x10000 TARGET Long   ; PS1, S18..S19
  FLASH.Create 10. 0xA04A0000--0xA04FFFFF 0x20000 TARGET Long   ; PS1, S20..S22
  FLASH.Create 11. 0xA0500000--0xA057FFFF 0x40000 TARGET Long   ; PS2, S23..S24
  FLASH.Create 12. 0xA0580000--0xA05FFFFF 0x40000 TARGET Long   ; PS3, S25..S26
  ; Program flash PF3
  FLASH.Create 13. 0xA0600000--0xA061FFFF  0x4000 TARGET Long   ; PS0, S0..S7
  FLASH.Create 13. 0xA0620000--0xA065FFFF  0x8000 TARGET Long   ; PS0, S8..S15
  FLASH.Create 13. 0xA0660000--0xA067FFFF 0x10000 TARGET Long   ; PS0, S16..S17
  FLASH.Create 14. 0xA0680000--0xA069FFFF 0x10000 TARGET Long   ; PS1, S18..S19
  FLASH.Create 14. 0xA06A0000--0xA06FFFFF 0x20000 TARGET Long   ; PS1, S20..S22
  FLASH.Create 15. 0xA0700000--0xA077FFFF 0x40000 TARGET Long   ; PS2, S23..S24
  FLASH.Create 16. 0xA0780000--0xA07FFFFF 0x40000 TARGET Long   ; PS3, S25..S26
  ; Data flash DF0
  FLASH.Create 17. 0xAF000000--0xAF0BFFFF  0x2000 TARGET Long /INFO "EEPROM"          ; DF0, EEPROM0..EEPROM95
  FLASH.Create 18. 0xAF100000--0xAF1003FF   0x400 NOP    Long /INFO "UCB_PFlash"      ; DF0, UCB0
  FLASH.Create 18. 0xAF100400--0xAF1007FF   0x400 NOP    Long /INFO "UCB_DFlash"      ; DF0, UCB1
  FLASH.Create 18. 0xAF100800--0xAF100BFF   0x400 NOP    Long /INFO "UCB_HSMCOTP"     ; DF0, UCB2
  FLASH.Create 18. 0xAF100C00--0xAF100FFF   0x400 NOP    Long /INFO "UCB_OTP"         ; DF0, UCB3
  FLASH.Create 18. 0xAF101000--0xAF1013FF   0x400 NOP    Long /INFO "UCB_IFX"         ; DF0, UCB4
  FLASH.Create 18. 0xAF101400--0xAF1017FF   0x400 NOP    Long /INFO "UCB_DBG"         ; DF0, UCB5
  FLASH.Create 18. 0xAF101800--0xAF101BFF   0x400 NOP    Long /INFO "UCB_HSM"         ; DF0, UCB6
  FLASH.Create 18. 0xAF101C00--0xAF101FFF   0x400 NOP    Long /INFO "UCB_HSMCFG"      ; DF0, UCB7
  FLASH.Create 18. 0xAF102000--0xAF102FFF   0x400 NOP    Long                         ; DF0, UCB8..UCB11
  FLASH.Create 18. 0xAF103000--0xAF103FFF   0x400 NOP    Long /INFO "Erase Counter"   ; DF0, UCB12..UCB15
  ; Data flash DF1
  FLASH.Create 19. 0xAF110000--0xAF11FFFF 0x02000 NOP    Long /INFO "HSM"             ; HSM0..HSM7

  ; Cached program flash address range
  FLASH.CreateALIAS 0x80000000--0x80FFFFFF 0xA0000000

  FLASH.TARGET 0xC0000000 0xD0000000 0x4000 ~~/demo/tricore/flash/long/tc2.bin

  ;========================================================================
  ; Example for download (Handle double addressing spaces A and 8)

  FLASH.ReProgram ALL

  Data.LOAD.Elf "&master_elf" 0x80000000--0x80001fff  ; PFLASH0 8k Cached
  Data.LOAD.Elf "&master_elf" 0x80004000--0x803fffff  ; PFLASH0 4M-16k Cached
  Data.LOAD.Elf "&master_elf" 0x8f000000--0x8f07ffff  ; DFLASH0 512k Cached
  Data.LOAD.Elf "&master_elf" 0x8f100000--0x8f103fff  ; DFLASH0 16k Cached
  Data.LOAD.Elf "&master_elf" 0x8f110000--0x8f117fff  ; DFLASH1 32k Cached

  Data.LOAD.Elf "&master_elf" 0xa0000000--0xa0001fff  ; PFLASH0 8k Not Cached
  Data.LOAD.Elf "&master_elf" 0xa0004000--0xa03fffff  ; PFLASH0 4M-16k Not Cached
  Data.LOAD.Elf "&master_elf" 0xaf000000--0xaf07ffff  ; DFLASH0 512k Not Cached
  Data.LOAD.Elf "&master_elf" 0xaf100000--0xaf103fff  ; DFLASH0 16k Not Cached
  Data.LOAD.Elf "&master_elf" 0xaf110000--0xaf117fff  ; DFLASH1 32k Not Cached

  if !("&cpu1_elf"=="")
  (
    Data.LOAD.Elf "&cpu1_elf" 0x80002000--0x80002fff  ; PFLASH0 4k Cached
    Data.LOAD.Elf "&cpu1_elf" 0x80400000--0x805fffff  ; PFLASH1 2M Cached
    Data.LOAD.Elf "&cpu1_elf" 0x8f080000--0x8f0bffff  ; DFLASH0 256k Cached
    Data.LOAD.Elf "&cpu1_elf" 0x8f118000--0x8f11bfff  ; DFLASH1 16k Cached

    Data.LOAD.Elf "&cpu1_elf" 0xa0002000--0xa0002fff  ; PFLASH0 4k Not Cached
    Data.LOAD.Elf "&cpu1_elf" 0xa0400000--0xa05fffff  ; PFLASH1 2M Not Cached
    Data.LOAD.Elf "&cpu1_elf" 0xaf080000--0xaf0bffff  ; DFLASH0 256k Not Cached
    Data.LOAD.Elf "&cpu1_elf" 0xaf118000--0xaf11bfff  ; DFLASH1 16k Not Cached
  )

  if !("&cpu2_elf"=="")
  (
    Data.LOAD.Elf "&cpu2_elf" 0x80003000--0x80003fff  ; PFLASH0 4k Cached
    Data.LOAD.Elf "&cpu2_elf" 0x80600000--0x807fffff  ; PFLASH1 2M Cached
    Data.LOAD.Elf "&cpu2_elf" 0x8f0c0000--0x8f0fffff  ; DFLASH0 256k Cached
    Data.LOAD.Elf "&cpu2_elf" 0x8f11c000--0x8f11ffff  ; DFLASH1 16k Cached

    Data.LOAD.Elf "&cpu2_elf" 0xa0003000--0xa0003fff  ; PFLASH0 4k Not Cached
    Data.LOAD.Elf "&cpu2_elf" 0xa0600000--0xa07fffff  ; PFLASH1 2M Not Cached
    Data.LOAD.Elf "&cpu2_elf" 0xaf0c0000--0xaf0fffff  ; DFLASH0 256k Not Cached
    Data.LOAD.Elf "&cpu2_elf" 0xaf11c000--0xaf11ffff  ; DFLASH1 16k Not Cached
  )

  ; Check if at one valid boot mode header is available
  LOCAL  &progflash
  GOSUB CheckBootModeHeader 0xa0000000
  ENTRY &progflash
  IF &progflash
    GOTO ProgramFlash
  GOSUB CheckBootModeHeader 0xa0020000
  ENTRY &progflash
  IF &progflash
    GOTO ProgramFlash
  GOSUB CheckBootModeHeader 0xa000ffe0
  ENTRY &progflash
  IF &progflash
    GOTO ProgramFlash
  GOSUB CheckBootModeHeader 0xa001ffe0
  ENTRY &progflash
  IF &progflash
    GOTO ProgramFlash

  DIALOG.YESNO "No valid Boot Mode Header found!" "Do you really want to program flash?"
  ENTRY &progflash
  IF !&progflash
  (
    ; Revert loaded data
    FLASH.ReProgram ALL
    FLASH.ReProgram off
  )

ProgramFlash: 
  FLASH.ReProgram off
;========================================================================
; Check what has been written in Flash

  GOSUB CheckFlashRange "&master_elf" 0x80000000--0x80001fff  ; PFLASH0 8k Cached
  GOSUB CheckFlashRange "&master_elf" 0x80004000--0x803fffff  ; PFLASH0 4M-16k Cached
  GOSUB CheckFlashRange "&master_elf" 0x8f000000--0x8f07ffff  ; DFLASH0 512k Cached
  GOSUB CheckFlashRange "&master_elf" 0x8f100000--0x8f103fff  ; DFLASH0 16k Cached
  GOSUB CheckFlashRange "&master_elf" 0x8f110000--0x8f117fff  ; DFLASH1 32k Cached

  GOSUB CheckFlashRange "&master_elf" 0xa0000000--0xa0001fff  ; PFLASH0 8k Not Cached
  GOSUB CheckFlashRange "&master_elf" 0xa0004000--0xa03fffff  ; PFLASH0 4M-16k Not Cached
  GOSUB CheckFlashRange "&master_elf" 0xaf000000--0xaf07ffff  ; DFLASH0 512k Not Cached
  GOSUB CheckFlashRange "&master_elf" 0xaf100000--0xaf103fff  ; DFLASH0 16k Not Cached
  GOSUB CheckFlashRange "&master_elf" 0xaf110000--0xaf117fff  ; DFLASH1 32k Not Cached

  if !("&cpu1_elf"=="")
  (
    GOSUB CheckFlashRange "&cpu1_elf" 0x80002000--0x80002fff  ; PFLASH0 4k Cached
    GOSUB CheckFlashRange "&cpu1_elf" 0x80400000--0x805fffff  ; PFLASH1 2M Cached
    GOSUB CheckFlashRange "&cpu1_elf" 0x8f080000--0x8f0bffff  ; DFLASH0 256k Cached
    GOSUB CheckFlashRange "&cpu1_elf" 0x8f118000--0x8f11bfff  ; DFLASH1 16k Cached

    GOSUB CheckFlashRange "&cpu1_elf" 0xa0002000--0xa0002fff  ; PFLASH0 4k Not Cached
    GOSUB CheckFlashRange "&cpu1_elf" 0xa0400000--0xa05fffff  ; PFLASH1 2M Not Cached
    GOSUB CheckFlashRange "&cpu1_elf" 0xaf080000--0xaf0bffff  ; DFLASH0 256k Not Cached
    GOSUB CheckFlashRange "&cpu1_elf" 0xaf118000--0xaf11bfff  ; DFLASH1 16k Not Cached
  )

  if !("&cpu2_elf"=="")
  (
    GOSUB CheckFlashRange "&cpu2_elf" 0x80003000--0x80003fff  ; PFLASH0 4k Cached
    GOSUB CheckFlashRange "&cpu2_elf" 0x80600000--0x807fffff  ; PFLASH1 2M Cached
    GOSUB CheckFlashRange "&cpu2_elf" 0x8f0c0000--0x8f0fffff  ; DFLASH0 256k Cached
    GOSUB CheckFlashRange "&cpu2_elf" 0x8f11c000--0x8f11ffff  ; DFLASH1 16k Cached
    
    GOSUB CheckFlashRange "&cpu2_elf" 0xa0003000--0xa0003fff  ; PFLASH0 4k Not Cached
    GOSUB CheckFlashRange "&cpu2_elf" 0xa0600000--0xa07fffff  ; PFLASH1 2M Not Cached
    GOSUB CheckFlashRange "&cpu2_elf" 0xaf0c0000--0xaf0fffff  ; DFLASH0 256k Not Cached
    GOSUB CheckFlashRange "&cpu2_elf" 0xaf11c000--0xaf11ffff  ; DFLASH1 16k Not Cached
  )

  QUIT

;========================================================================
; Check if Boot Mode Header has valid contents

CheckBootModeHeader:
  LOCAL &addr
  ENTRY &addr

  LOCAL &result
  &result=TRUE()

  ON ERROR GOSUB
  (
    &result=FALSE()
    RETURN
  )

  Data.SUM &addr++0x17 /Long /ByteSWAP /CRC32
  IF &result
  (
    Data.Set &addr+0x18 %Long DATA.SUM() /DIFF
    IF &result
    (
      &result=!FOUND()
      IF &result
      (
        Data.Set &addr+0x1c %Long ~DATA.SUM() /DIFF
        IF &result
        (
          &result=!FOUND()
        )
      )
    )
  )

  RETURN &result

;========================================================================
; Check Flash contents
CheckFlashRange:
    LOCAL &elf_path &range
    ENTRY  &elf_path &range
    Data.LOAD.Elf "&elf_path" &range /DIFF
    IF FOUND()
    (
      PRINT "Difference found at address " address.offset(Track.address())
    )

  RETURN

